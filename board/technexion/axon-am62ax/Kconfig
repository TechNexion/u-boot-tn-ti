## board/technexion/axon-am62ax/Kconfig
```kconfig
# SPDX-License-Identifier: GPL-2.0+
#
# Copyright (C) 2022 Texas Instruments Incorporated - https://www.ti.com/
# Copyright 2023 TechNexion Ltd.
# Author: Ray Chang <ray.chang@technexion.com>
#

choice
	prompt "TechNexion AXON-AM62AX SoM"
	optional

config TARGET_AXON_AM62AX_A53
	bool "AXON-AM62AX running on A53"
	select ARM64
	select SOC_K3_AM62A7
	imply BOARD
	imply SPL_BOARD
	imply TI_I2C_BOARD_DETECT

config TARGET_AXON_AM62AX_R5
	bool "AXON-AM62AX running on R5"
	select CPU_V7R
	select SYS_THUMB_BUILD
	select K3_LOAD_SYSFW
	select SOC_K3_AM62A7
	select RAM
	select SPL_RAM
	select K3_DDRSS
	imply SYS_K3_SPL_ATF
	imply TI_I2C_BOARD_DETECT

endchoice

if TARGET_AXON_AM62AX_R5 || TARGET_AXON_AM62AX_A53

config SYS_BOARD
	default "axon-am62ax"

config SYS_VENDOR
	default "technexion"

config SYS_CONFIG_NAME
	default "axon-am62ax"

source "board/ti/common/Kconfig"

endif

if TARGET_AXON_AM62AX_R5

config SPL_LDSCRIPT
	default "arch/arm/mach-omap2/u-boot-spl.lds"

endif
```

## board/technexion/axon-am62xx/Kconfig
```kconfig
# SPDX-License-Identifier: GPL-2.0+
#
# Copyright (C) 2024 TechNexion Ltd.
#

if TARGET_AXON_AM62XX_A53 || TARGET_AXON_AM62XX_R5

config SYS_BOARD
       default "axon-am62xx"

config SYS_VENDOR
       default "technexion"

config SYS_CONFIG_NAME
       default "axon-am62xx"

source "board/ti/common/Kconfig"
source "board/technexion/common/Kconfig"

endif

if TARGET_AXON_AM62XX_R5

config SPL_LDSCRIPT
	default "arch/arm/mach-omap2/u-boot-spl.lds"

endif
```

## board/technexion/common/Kconfig
```kconfig
config TN_BOARD_EEPROM
	bool "Support for EEPROM information for TechNexion platforms"
	help
	   Support for specific format and information on TechNexion's
	   SoM which have I2C based EEPROM
```

## board/technexion/rovy-4vm/Kconfig
```kconfig
# SPDX-License-Identifier: GPL-2.0+
#
# Copyright (C) 2024 TechNexion Ltd. - https://www.technexion.com/
#

choice
	prompt "TechNexion ROVY-4VM"
	optional

config TARGET_ROVY_4VM_A72
	bool "TechNexion ROVY-4VM running on A72"
	select ARM64
	select BOARD_LATE_INIT
	select SYS_DISABLE_DCACHE_OPS
	select BINMAN

config TARGET_ROVY_4VM_R5
	bool "TechNexion ROVY-4VM running on R5"
	select CPU_V7R
	select SYS_THUMB_BUILD
	select K3_LOAD_SYSFW
	select RAM
	select SPL_RAM
	select K3_DDRSS
	select BINMAN
	imply SYS_K3_SPL_ATF

endchoice

if TARGET_ROVY_4VM_A72

config SYS_BOARD
       default "rovy-4vm"

config SYS_VENDOR
       default "technexion"

config SYS_CONFIG_NAME
       default "rovy-4vm"

config ENV_SOURCE_FILE
       default "rovy-4vm"

source "board/ti/common/Kconfig"

endif

if TARGET_ROVY_4VM_R5

config SYS_BOARD
       default "rovy-4vm"

config SYS_VENDOR
       default "technexion"

config SYS_CONFIG_NAME
       default "rovy-4vm"

config SPL_LDSCRIPT
	default "arch/arm/mach-omap2/u-boot-spl.lds"

source "board/ti/common/Kconfig"

endif
```
